

#include "stm32f10x.h"
#include "hw_config.h"
#include "spi.h"
#include "vs1003b.h"

u8 vs1003ram[5]={0,0,0,0,250};

const u8 atab[943] = { /* Register addresses */
    7, 6, 6, 6, 6, 6, 6, 6, 6, 6, 6, 6, 6, 6, 6, 6,
    6, 6, 6, 6, 6, 6, 6, 6, 6, 7, 6, 6, 6, 6, 6, 6,
    6, 6, 6, 6, 6, 6, 6, 6, 6, 6, 6, 6, 6, 6, 6, 6,
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    6, 6, 6, 6, 6, 6, 6, 6, 6, 6, 6, 6, 6, 6, 10
};
const u16 dtab[943] = { /* Data to write */
    0x8050, 0x3613, 0x0024, 0x3e00, 0x3801, 0x0000, 0x16d7, 0xf400,
    0x55c0, 0x0000, 0x0a17, 0xf400, 0x57c0, 0x0006, 0x5017, 0xb080,
    0x0024, 0x3f00, 0x0024, 0x2000, 0x0000, 0x36f0, 0x1801, 0x2800,
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    0x0000, 0x0980, 0x2000, 0x0000, 0x6010, 0x0024, 0x0050
};


u16 Vs1003_Init(void)
{		  
	u16 retry;
	GPIO_InitTypeDef GPIO_InitStructure;
	
	// DREQ
	GPIO_InitStructure.GPIO_Pin = MP3_DREQ;
	GPIO_InitStructure.GPIO_Speed = GPIO_Speed_50MHz;
	GPIO_InitStructure.GPIO_Mode = GPIO_Mode_IPU;
	GPIO_Init(MP3_DREQ_PORT, &GPIO_InitStructure);
	
	// XCS, XDCS
	GPIO_InitStructure.GPIO_Pin = MP3_CMD_CS | MP3_DATA_CS;			
	GPIO_InitStructure.GPIO_Speed = GPIO_Speed_50MHz;
	GPIO_InitStructure.GPIO_Mode = GPIO_Mode_Out_PP;
	GPIO_Init(MP3_CCS_PORT, &GPIO_InitStructure);
	
	// XRESET
	GPIO_InitStructure.GPIO_Pin = MP3_XREST;
	GPIO_InitStructure.GPIO_Speed = GPIO_Speed_50MHz;
	GPIO_InitStructure.GPIO_Mode = GPIO_Mode_Out_PP;
	GPIO_Init(MP3_XREST_PORT, &GPIO_InitStructure); 
	
	MP3_CCS_SET(1);
	MP3_DCS_SET(1);	

	MP3_RST_SET(0);
	delay_ms(80);
	MP3_RST_SET(1);

	bsp_set_spi2_speed_mp3(SPI_SPEED_LOW);

	delay_ms(40);//delay

	retry=0;

	while(Vs1003_REG_Read(SPI_CLOCKF)!=CLOCK_REG)//设set vs1003 clock, 3 octave, 1.5xADD
	{
		Vs1003_CMD_Write(SPI_CLOCKF,CLOCK_REG);//设set vs1003 clock, 3 octave, 1.5xADD
		if(retry++>200)
			return 1; 
	}		   

	delay_ms(40);//delay

#if 1
	retry=0;
	while(Vs1003_REG_Read(0x0b) != DefaultVolume)//set Volume
	{
		Vs1003_CMD_Write(0x0b,DefaultVolume);
		if(retry++ >200 )return 1;
	}
#endif
	
#if 1
	retry=0;
	while(Vs1003_REG_Read(0x00) != 0x0800)//set mode register
	{
		Vs1003_CMD_Write(0x00, 0x0800);
		if(retry++ >200 )return 1;//
	}
#endif	

	delay_ms(40);//delay

	Vs1003SoftReset();

	delay_ms(40);

	bsp_set_spi2_speed_mp3(SPI_SPEED_HIGH);

	return 0;

}

				 				
void Vs1003SoftReset(void)
{
	bsp_set_spi2_speed_mp3(SPI_SPEED_HIGH);

	Vs1003_CMD_Write(0x00,0x0804);

	delay_ms(40);
} 

void VS1003B_Reset(void)
{
	MP3_RST_SET(0);
	delay_ms(100);
	bsp_readwritebyte_spi2(0XFF);
	
	MP3_CCS_SET(1);
	MP3_DCS_SET(1);
	MP3_RST_SET(1);    		



	delay_ms(100);
	while(VS1003B_NeedData()==0);
	delay_ms(100);

	Vs1003SoftReset();			 
}

void VsSineTest(void)
{	
   	Vs1003_CMD_Write(0x0b,0X2020);
 	Vs1003_CMD_Write(SPI_MODE,0x0820);
	while((MP3_DREQ_PORT->IDR & MP3_DREQ)==0);
 	// 0x53 0xef 0x6e n 0x00 0x00 0x00 0x00
 	
    MP3_DCS_SET(0);
	bsp_readwritebyte_spi2(0x53);
	bsp_readwritebyte_spi2(0xef);
	bsp_readwritebyte_spi2(0x6e);
	bsp_readwritebyte_spi2(0x24);
	bsp_readwritebyte_spi2(0x00);
	bsp_readwritebyte_spi2(0x00);
	bsp_readwritebyte_spi2(0x00);
	bsp_readwritebyte_spi2(0x00);
	delay_ms(100);
	MP3_DCS_SET(1); 
    
    MP3_DCS_SET(0);
	bsp_readwritebyte_spi2(0x45);
	bsp_readwritebyte_spi2(0x78);
	bsp_readwritebyte_spi2(0x69);
	bsp_readwritebyte_spi2(0x74);
	bsp_readwritebyte_spi2(0x00);
	bsp_readwritebyte_spi2(0x00);
	bsp_readwritebyte_spi2(0x00);
	bsp_readwritebyte_spi2(0x00);
	delay_ms(100);
	MP3_DCS_SET(1);		 

    
    MP3_DCS_SET(0);
	bsp_readwritebyte_spi2(0x53);
	bsp_readwritebyte_spi2(0xef);
	bsp_readwritebyte_spi2(0x6e);
	bsp_readwritebyte_spi2(0x44);
	bsp_readwritebyte_spi2(0x00);
	bsp_readwritebyte_spi2(0x00);
	bsp_readwritebyte_spi2(0x00);
	bsp_readwritebyte_spi2(0x00);
	delay_ms(100);
	MP3_DCS_SET(1);

    MP3_DCS_SET(0);
	bsp_readwritebyte_spi2(0x45);
	bsp_readwritebyte_spi2(0x78);
	bsp_readwritebyte_spi2(0x69);
	bsp_readwritebyte_spi2(0x74);
	bsp_readwritebyte_spi2(0x00);
	bsp_readwritebyte_spi2(0x00);
	bsp_readwritebyte_spi2(0x00);
	bsp_readwritebyte_spi2(0x00);
	delay_ms(100);
	MP3_DCS_SET(1);	 
}	 

void VsRamTest(void)
{
	u16 regvalue=0;	   

	VS1003B_Reset();     

 	Vs1003_CMD_Write(SPI_MODE,0x0820);
	while ((MP3_DREQ_PORT->IDR & MP3_DREQ)==0);
 	MP3_DCS_SET(0);	       			  // xDCS = 1
	bsp_readwritebyte_spi2(0x4d);
	bsp_readwritebyte_spi2(0xea);
	bsp_readwritebyte_spi2(0x6d);
	bsp_readwritebyte_spi2(0x54);
	bsp_readwritebyte_spi2(0x00);
	bsp_readwritebyte_spi2(0x00);
	bsp_readwritebyte_spi2(0x00);
	bsp_readwritebyte_spi2(0x00);
	delay_ms(50);  
	MP3_DCS_SET(1);
	regvalue=Vs1003_REG_Read(SPI_HDAT0);

}     

void Vs1003_CMD_Write(u8 address,u16 data)
{  
    // while((MP3_DREQ_PORT->IDR & MP3_DREQ)==0);
	//bsp_set_spi2_speed_mp3(SPI_SPEED_LOW);
	 
	MP3_DCS_SET(1); //MP3_DATA_CS=1;
	MP3_CCS_SET(0); //MP3_CMD_CS=0; 

	bsp_readwritebyte_spi2(VS_WRITE_COMMAND);
	bsp_readwritebyte_spi2(address);
	bsp_readwritebyte_spi2(data>>8);
	bsp_readwritebyte_spi2(data);
	MP3_CCS_SET(1);

	//bsp_set_spi2_speed_mp3(SPI_SPEED_HIGH);

} 

u16 Vs1003_REG_Read(u8 address)
{ 

	u16 temp=0; 

    // while((MP3_DREQ_PORT->IDR&MP3_DREQ)==0);

	// bsp_set_spi2_speed_mp3(SPI_SPEED_LOW);
	MP3_DCS_SET(1);       //MP3_DATA_CS=1;
	MP3_CCS_SET(0);       //MP3_CMD_CS=0;
	bsp_readwritebyte_spi2(VS_READ_COMMAND);
	bsp_readwritebyte_spi2(address);
	temp=bsp_readwritebyte_spi2(0xff);
	temp=temp<<8;

	temp|=bsp_readwritebyte_spi2(0xff);
	MP3_CCS_SET(1);      //MP3_CMD_CS=1; 

//	bsp_set_spi2_speed_mp3(SPI_SPEED_HIGH);

    return temp; 
}  
//FOR WAV HEAD0 :0X7761 HEAD1:0X7665    
//FOR MIDI HEAD0 :other info HEAD1:0X4D54
//FOR WMA HEAD0 :data speed HEAD1:0X574D
//FOR MP3 HEAD0 :data speed HEAD1:ID
const u16 bitrate[2][16]=
{ 
{0,8,16,24,32,40,48,56,64,80,96,112,128,144,160,0}, 
{0,32,40,48,56,64,80,96,112,128,160,192,224,256,320,0}
};

u16 GetHeadInfo(void)
{
	unsigned int HEAD0;
	unsigned int HEAD1;            
    HEAD0=Vs1003_REG_Read(SPI_HDAT0); 
    HEAD1=Vs1003_REG_Read(SPI_HDAT1);
    switch(HEAD1)
    {        
        case 0x7665:return 0;//WAV
        case 0X4D54:return 1;//MIDI
        case 0X574D://WMA
        {
            HEAD1=HEAD0*2/25;
            if((HEAD1%10)>5)return HEAD1/10+1;
            else return HEAD1/10;
        }
        default://MP3
        {
            HEAD1>>=3;
            HEAD1=HEAD1&0x03; 
            if(HEAD1==3)HEAD1=1;
            else HEAD1=0;
            return bitrate[HEAD1][HEAD0>>12];
        }
    } 
}  

void ResetDecodeTime(void)
{
	Vs1003_CMD_Write(SPI_DECODE_TIME,0x0000);
	Vs1003_CMD_Write(SPI_DECODE_TIME,0x0000);
}

u16 GetDecodeTime(void)
{ 
    return Vs1003_REG_Read(SPI_DECODE_TIME);   
} 

void LoadPatch(void)
{
	u16 i;
	for (i=0;i<943;i++)Vs1003_CMD_Write(atab[i],dtab[i]); 
	delay_ms(10);
}

void GetSpec(u8 *p)
{
	u8 byteIndex=0;
	u8 temp;
	Vs1003_CMD_Write(SPI_WRAMADDR,0x1804);                                                                                             
	for (byteIndex=0;byteIndex<14;byteIndex++) 
	{                                                                               
		temp=Vs1003_REG_Read(SPI_WRAM)&0x63;
		*p++=temp;
	} 
}

void set1003(void)
{
    u8 t;
    u16 bass=0;
    u16 volt=0;
    u8 vset=0;
    vset=255-vs1003ram[4];
    volt=vset;
    volt<<=8;
    volt+=vset;
     //0,henh.1,hfreq.2,lenh.3,lfreq        
    for(t=0;t<4;t++)
    {
        bass<<=4;
        bass+=vs1003ram[t]; 
    }     
	Vs1003_CMD_Write(SPI_BASS,bass);//BASS   
    Vs1003_CMD_Write(SPI_VOL,volt);
} 
    
void Vs1003_DATA_Write(unsigned char * buf)
{
	unsigned char  n = 32;

	MP3_DCS_SET(0);   //MP3_DATA_CS=0;
	while(n--)
	{
		bsp_readwritebyte_spi2(*buf++);
	}
	MP3_DCS_SET(1);   //MP3_DATA_CS=1;
	MP3_CCS_SET(1);   //MP3_CMD_CS=1; 
}


u16 VS1003B_NeedData(void)
{
	if( GPIO_ReadInputDataBit(MP3_DREQ_PORT,MP3_DREQ) )
		return 1;
	else
		return 0;
}


/* fill 2048 zero */   
void VS1003B_Fill2048Zero(void)   
{   
    u16 i,j;   
    for(i=0;i<64;i++)   
    {   
        MP3_DCS_SET(0);   
        while(VS1003B_NeedData()==0);   
        for(j=0;j<32;j++)   
        {   
            bsp_readwritebyte_spi2(0x00);   
        }   
        MP3_DCS_SET(1);   
    }   
} 

void vs1003b_volume_set(u16 vol)
{
	Vs1003_CMD_Write(0x0b,vol);
}
